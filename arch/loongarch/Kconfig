## arch/loongarch/la64/Kconfig
```kconfig
# SPDX-License-Identifier: GPL-2.0
if MACH_LOONGSON64

choice
	prompt "Machine Type"

config LOONGSON_MACH3X
	bool "Generic Loongson 3 family machines"
	select ARCH_SPARSEMEM_ENABLE
	select ARCH_MIGHT_HAVE_PC_PARPORT
	select ARCH_MIGHT_HAVE_PC_SERIO
	select GENERIC_ISA_DMA_SUPPORT_BROKEN
	select BOOT_ELF32
	select BOARD_SCACHE
	select CSRC_R4K
	select CEVT_R4K
	select CPU_HAS_WB
	select HAVE_CLK
	select HW_HAS_PCI
	select ISA
	select HT_PCI
	select IRQ_LOONGARCH_CPU
	select NR_CPUS_DEFAULT_4
	select SPARSE_IRQ
	select SYS_HAS_CPU_LOONGSON3
	select SYS_HAS_EARLY_PRINTK
	select SYS_SUPPORTS_SMP
	select SYS_SUPPORTS_HOTPLUG_CPU
	select SYS_SUPPORTS_NUMA
	select SYS_SUPPORTS_64BIT_KERNEL
	select SYS_SUPPORTS_HIGHMEM
	select SYS_SUPPORTS_LITTLE_ENDIAN
	select LOONGSON_MC146818
	select ZONE_DMA32
	select DMA_MAYBE_COHERENT
	select LEFI_FIRMWARE_INTERFACE
	select USE_OF
	select BUILTIN_DTB

	help
		Generic Loongson 3 family machines utilize the 3A/3B revision
		of Loongson processor and LS7A chipset.
endchoice

config LOONGSON_HPET
	bool "Loongson HPET Timer"
	depends on LOONGSON_MACH3X
	select LOONGARCH_EXTERNAL_TIMER
	help
	  This option enables the hpet timer of LS2H or LS7A or AMD RS780/SBX00.

	  If you want to enable the Loongson3 CPUFreq Driver, Please enable
	  this option at first, otherwise, You will get wrong system time.

	  If unsure, say Yes.

config GS464E_NODE_COUNTER
	bool "Loongson3 Node Counter"
	depends on LOONGSON_MACH3X
	select LOONGARCH_EXTERNAL_TIMER
	help
	  This option enables the node counter of Loongson3A(B)2000/3000/4000.

	  If you want to ease the contension of AMD RS780/SBX0 HPET device space reading,
	  Please enable this option. This option replace HPET CSRC with node counter.

	  If unsure, say No.

config LOONGSON_UART_BASE
	bool
	default y
	depends on EARLY_PRINTK || SERIAL_8250

config LOONGSON_MC146818
	bool
	default n

config LEFI_FIRMWARE_INTERFACE
	bool

endif # MACH_LOONGSON64
```

## drivers/gpu/drm/lsdc/Kconfig
```kconfig
config DRM_LSDC
	tristate "Kernel modesetting driver for loongson display controller"
	depends on DRM
	depends on (MIPS && MACH_LOONGSON64) || COMPILE_TEST
	select OF
	select I2C_GPIO if (DRM_LSDC_PLATFORM_DRIVER && CPU_LOONGSON2K)
	select GPIO_LS2K if (DRM_LSDC_PLATFORM_DRIVER && CPU_LOONGSON2K)
	select CMA if HAVE_DMA_CONTIGUOUS
	select DMA_CMA if HAVE_DMA_CONTIGUOUS
	select DRM_KMS_HELPER
	select DRM_KMS_FB_HELPER
	select DRM_GEM_CMA_HELPER
	select DRM_KMS_CMA_HELPER
	default m
	help
	  This is a KMS driver support for the display controller
	  in the LS7A1000 bridge or LS2K1000 SOC.

	  Note that this driver is different from the loongson KMS
	  driver (loongson.ko), the loongson KMS driver using TTM
	  memory manager and its framebuffer is located in VRAM.
	  This driver is based-on CMA and DMA_CMA. This driver is not
	  enabled on LS7A1000 + LS3A3000/LS3A4000 platform.
	  Pass the following parameter to the kernel commnad line
	  if you would like to have a try.

	    loongson.enable=0 lsdc.modeset=1

	  If "M" is selected, the module will be called lsdc.

config DRM_LSDC_PCI_DRIVER
	bool "Enable pci device driver support for DC in LS7A1000 Bridge"
	depends on DRM_LSDC
	depends on PCI
	depends on CPU_LOONGSON3
	default y
	help
	  Choose this if you want to use CMA-base kernel modesetting driver
	  for the display controller in ls7a1000.

	  DRM_LSDC_PCI_DRIVER will be defined on when lsdc is a pci device

	  If in doubt, say "Y".

config DRM_LSDC_PLATFORM_DRIVER
	bool "Enable platform driver support for the DC in LS2K1000 SoC"
	depends on DRM_LSDC
	depends on CPU_LOONGSON2K
	default y
	help
	  Choose this if you want to use CMA-base kernel modesetting driver
	  on LOONGSON-2K1000 SoC

	  DRM_LSDC_PLATFORM_DRIVER will be defined on when lsdc is a platform
	  device

	  If in doubt, say "Y".
```
